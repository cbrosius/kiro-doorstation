## main/Kconfig
```kconfig
menu "Door Station Configuration"

    config DOOR_STATION_AP_SSID
        string "SoftAP SSID"
        default "ESP32-Doorbell"
        help
            SSID of the SoftAP created by the device for configuration.

    config DOOR_STATION_AP_PASSWORD
        string "SoftAP Password"
        default "doorstation123"
        help
            Password of the SoftAP created by the device for configuration.
            Must be at least 8 characters long.

endmenu
```

## sdkconfig.defaults
```kconfig
# WiFi Configuration
CONFIG_ESP_COEX_SW_COEXIST_ENABLE=y
CONFIG_ESP_WIFI_STATIC_RX_BUFFER_NUM=10
CONFIG_ESP_WIFI_DYNAMIC_RX_BUFFER_NUM=32
CONFIG_DOOR_STATION_AP_SSID="ESP32-Doorbell"
CONFIG_DOOR_STATION_AP_PASSWORD="doorstation123"

# TCP/IP Configuration
CONFIG_LWIP_MAX_SOCKETS=16
CONFIG_LWIP_SO_REUSE=y
CONFIG_LWIP_SO_RCVBUF=y

# HTTP Server
CONFIG_HTTPD_MAX_REQ_HDR_LEN=1024
CONFIG_HTTPD_MAX_URI_LEN=512

# Audio/I2S
# CONFIG_ESP32_I2S_ENABLE_APLL removed in ESP-IDF v5 (APLL always available on ESP32-S3)

# FreeRTOS
CONFIG_FREERTOS_HZ=1000
CONFIG_ESP_MAIN_TASK_STACK_SIZE=8192

# Logging
CONFIG_LOG_DEFAULT_LEVEL_INFO=y
CONFIG_LOG_MAXIMUM_LEVEL_VERBOSE=y

# NVS
CONFIG_NVS_ENCRYPTION=n

# Partition Table
CONFIG_PARTITION_TABLE_CUSTOM=y
CONFIG_PARTITION_TABLE_CUSTOM_FILENAME="partitions.csv"

# OTA Configuration
CONFIG_BOOTLOADER_APP_ROLLBACK_ENABLE=y

# LCD components not used in door station (no override needed in v5.x)

# Flash size
CONFIG_ESPTOOLPY_FLASHSIZE_16MB=y
CONFIG_ESPTOOLPY_FLASHSIZE="16MB"
```
